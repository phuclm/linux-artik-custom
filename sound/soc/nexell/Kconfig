## sound/soc/nexell/Kconfig
```kconfig
#
# Copyright 2016 Nexell.
# Changelog:
#   12/10/2017 phuclm@lumi.com.vn add ZL38063 driver.
#
# Configuration options for the Nexell Sound


config SND_NX_SOC
	tristate "Nexell SoC Audio"
	depends on ARCH_S5P4418 || ARCH_S5P6818
	select AMBA_PL08X
	help
	  Say Y or M if you want to add support for codecs attached to
	  the AC97 and I2S interface.

config SND_NX_I2S
	tristate

config SND_NX_I2S_CH0
	bool "I2S 0"
	depends on SND_NX_SOC
	select SND_NX_I2S
	default y

config SND_NX_I2S_CH1
	bool "I2S 1"
	depends on SND_NX_SOC
	select SND_NX_I2S
	default n

config SND_NX_I2S_CH2
	bool "I2S 2"
	depends on SND_NX_SOC
	select SND_NX_I2S
	default n

config SND_NX_SPDIF_TX
	tristate

config SND_SPDIF_TRANSCEIVER
	tristate "SPDIF transceiver (PCM)"
	depends on SND_NX_SOC
	select SND_NX_SPDIF_TX
	select SND_SOC_SPDIF

config SND_CODEC_NULL
	tristate "I2S audio null codec."
	depends on SND_NX_I2S

config SND_CODEC_ES8316
	tristate "es8316 I2S audio codec."
	depends on SND_NX_I2S
	select SND_SOC_ES8316

config SND_CODEC_ALC5658
	tristate "ALC5658 I2S audio codec."
	depends on SND_NX_I2S
	select SND_SOC_RT5659
	
# phuclm@lumi.com.vn add ZL38063 driver
config SND_CODEC_ZL380xx
    tristate "ZL38063 I2S audio codec"
    depends on SND_NX_I2S
    select SND_SOC_ZL380xx
    
config SND_CODEC_TAS5720
    tristate "TAS5720 I2S audio codec"
    depends on SND_NX_I2S
    select SND_SOC_TAS5720
```
